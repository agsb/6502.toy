FOLD
FIND
REST
HUNT
HIDE
WAKE
ROPE
ALSO
BIND

AUTO
AWAY
BACK
BANK
BEAM
BEAT
BEEN
BIAS
BODY
BOLT
BUSY
BYTE
CANT
CASE
CAST
CHAR
CODE
COLD
COPY
DATA
DATE
DEEP
DISK
DOES
DONE
DOOR
DOWN
DROP
DUMB
DUMP
EACH
ENDO
EVAL
FAIL
FEED
FEEL
FILE
FORK
FORM
FREE
GAVE
GIVE
HALF
HALT
HARS
HATE
HEAD
HEAP
HERE
HIGH
HINT
HIRE
HOLD
HOOK
HOST
IDLE
INIT
INTO
JUST
KEEP
KILL
KNEW
KNOW
LAKE
LAST
LEAF
LEAP
LEFT
LESS
LIFT
LINE
LINK
LIST
LIVE
LOAD
LOCK
LONG
LOST
LOVE
MAKE
MANY
MESH
MISS
MODE
MORE
MOST
MOVE
MUST
MUTE
NEAR
NEED
NEXT
NODE
NONE
NULL
ONLY
OPEN
OVER
PAGE
PASS
PEEK
PLAY
PLUS
POKE
POLY
POOL
PORT
POST
PULL
PUSH
QUIT
REEL
RING
ROLL
ROOM
SAVE
SCAN
SEEK
SEEM
SEND
SENT
SHOW
SICK
SIDE
SIGN
SKIP
SLIP
SLOT
SOME
SPIN
STAR
STAT
STEP
STOP
SWAP
TAIL
TAKE
TAPE
TASK
TELL
TERM
TEST
TEXT
THAT
THIS
TILT
TIME
TODO
TOKE
TOOK
TOOL
TOSS
TRAP
TURN
USED
USER
VARY
VERY
VOID
WAIT
WAKE
WALK
WARN
WASH 
WENT
WERE
WILL
WIND
WIRE
WISH
WITH
WORD
WORK
ZERO
